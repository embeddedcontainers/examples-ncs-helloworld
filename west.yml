## west.yml
```yaml
manifest:
  self:
    west-commands: scripts/west-commands.yml
    path: app

  remotes:
    - name: ncs
      url-base: https://github.com/nrfconnect

  projects:
    - name: nrf
      remote: ncs
      repo-path: sdk-nrf
      revision: main
      import:
        path-prefix: deps
```
